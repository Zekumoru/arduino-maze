#include "Map.hpp"
#include "definitions.hpp"

const uint8_t mazeMap[MAP_HEIGHT][MAP_WIDTH] PROGMEM = {
  { 1, 1, 0, 1, 1, 1, 1, 1, 1, 1, 1, 1, 1, 1, 1, 1, 1, 1, 1, 1, 1, 1, 1, 1, 1, 1, 1, 1, 1, 1, 1, 1 },
  { 1, 0, 0, 0, 0, 0, 0, 0, 1, 0, 0, 0, 0, 0, 1, 0, 0, 0, 0, 0, 0, 0, 0, 0, 0, 0, 1, 0, 0, 0, 1, 1 },
  { 1, 0, 0, 0, 1, 1, 1, 0, 1, 0, 1, 0, 1, 1, 1, 0, 1, 1, 1, 1, 1, 1, 1, 0, 1, 0, 1, 1, 1, 0, 1, 1 },
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  { 1, 0, 0, 1, 1, 1, 1, 1, 1, 1, 1, 1, 1, 1, 1, 1, 1, 1, 1, 1, 1, 1, 1, 1, 1, 1, 1, 1, 1, 1, 1, 1 }
};

uint8_t getMazeTile(int x, int y)
{
  return pgm_read_byte(&(mazeMap[y][x]));
}

uint8_t miniMap[MAP_HEIGHT][MAP_WIDTH];

void resetMiniMap()
{
  for (int y = 0; y < MAP_HEIGHT; y++)
    for (int x = 0; x < MAP_WIDTH; x++)
      miniMap[y][x] = 0;
}

void unlockMiniMapArea(int xPos, int yPos)
{
  if (xPos < 1)
    xPos = 1;
  else if (xPos >= MAP_WIDTH - 1)
    xPos = MAP_WIDTH - 2;

  if (yPos < 1)
    yPos = 1;
  else if (yPos >= MAP_HEIGHT - 1)
    yPos = MAP_HEIGHT - 2;

  // top row
  miniMap[(yPos - 1)][(xPos - 1)] = 1;
  miniMap[(yPos - 1)][xPos] = 1;
  miniMap[(yPos - 1)][(xPos + 1)] = 1;
  // midlle row
  miniMap[yPos][(xPos - 1)] = 1;
  miniMap[yPos][(xPos + 1)] = 1;
  // bottom row
  miniMap[(yPos + 1)][(xPos - 1)] = 1;
  miniMap[(yPos + 1)][xPos] = 1;
  miniMap[(yPos + 1)][(xPos + 1)] = 1;
}

void setMiniMap(int xPos, int yPos)
{
  miniMap[yPos][xPos] = 1;
  unlockMiniMapArea(xPos, yPos);
}
